## main/Kconfig.projbuild
```kconfig
menu "Field Pocket Watch"

    config I2C_MASTER_FREQUENCY
        int "I2C master bus frequency (Hz)"
        default 400000
        help
            Clock speed for the shared I2C peripheral bus (FT3168 touch,
            AXP2101 PMU, and in later steps the QMI8658 IMU and PCF85063 RTC).
            The board support package uses this value for the touch
            controller's I2C speed. 400 kHz (fast mode) is the board default.

endmenu
```

## sdkconfig.defaults
```kconfig
# Field Pocket Watch — ESP-IDF build defaults
# Applied on first configure; user overrides land in sdkconfig (gitignored).

# --- Target ---
CONFIG_IDF_TARGET="esp32s3"

# --- CPU ---
CONFIG_ESP_DEFAULT_CPU_FREQ_MHZ_240=y

# --- Flash: 32MB QIO @ 80MHz ---
CONFIG_ESPTOOLPY_FLASHMODE_QIO=y
CONFIG_ESPTOOLPY_FLASHFREQ_80M=y
CONFIG_ESPTOOLPY_FLASHSIZE_32MB=y
CONFIG_ESPTOOLPY_FLASHSIZE="32MB"

# --- Custom partition table ---
CONFIG_PARTITION_TABLE_CUSTOM=y
CONFIG_PARTITION_TABLE_CUSTOM_FILENAME="partitions.csv"

# --- FATFS: long filenames so SD log files can use full IST timestamps ---
CONFIG_FATFS_LFN_HEAP=y
CONFIG_FATFS_MAX_LFN=255

# --- PSRAM (ESP32-S3R8: 8MB octal SPI RAM) ---
CONFIG_SPIRAM=y
CONFIG_SPIRAM_MODE_OCT=y
CONFIG_SPIRAM_SPEED_80M=y

# --- FreeRTOS: 1kHz tick keeps LVGL animations smooth ---
CONFIG_FREERTOS_HZ=1000

# --- Main task gets headroom for UI bring-up ---
CONFIG_ESP_MAIN_TASK_STACK_SIZE=8192

# --- Console on the native USB-Serial/JTAG (the single USB-C port = COM6) ---
# Routes logs AND interactive input (the settime REPL) over the same port we
# flash/monitor on, instead of UART0 on GPIO43/44.
CONFIG_ESP_CONSOLE_USB_SERIAL_JTAG=y

# --- LVGL ---
# RGB565 to match the SH8601 QSPI panel; enable the Montserrat font sizes the
# Field Pocket Watch design system uses (time 48, recorder timer 36, labels 14,
# hints 10). Montserrat 14 is LVGL's default and stays the fallback font.
CONFIG_LV_COLOR_DEPTH_16=y
CONFIG_LV_FONT_MONTSERRAT_10=y
CONFIG_LV_FONT_MONTSERRAT_14=y
CONFIG_LV_FONT_MONTSERRAT_20=y
CONFIG_LV_FONT_MONTSERRAT_28=y
CONFIG_LV_FONT_MONTSERRAT_36=y
CONFIG_LV_FONT_MONTSERRAT_48=y
```
